## companion/image/meta-vtol/conf/layer.conf
```bitbake
BBPATH .= ":${LAYERDIR}"
BBFILES += "${LAYERDIR}/recipes-*/*/*.bb ${LAYERDIR}/recipes-*/*/*.bbappend"
BBFILE_COLLECTIONS += "vtol"
BBFILE_PATTERN_vtol = "^${LAYERDIR}/"
BBFILE_PRIORITY_vtol = "10"
LAYERSERIES_COMPAT_vtol = "scarthgap"
LAYERDEPENDS_vtol = "core raspberrypi"
```
